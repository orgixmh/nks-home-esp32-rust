## sdkconfig.defaults
```kconfig
# Rust often needs a bit of an extra main task stack size compared to C (the default is 3K)
CONFIG_ESP_MAIN_TASK_STACK_SIZE=12288
CONFIG_ESP_SYSTEM_EVENT_TASK_STACK_SIZE=4096
CONFIG_FREERTOS_IDLE_TASK_STACKSIZE=4096
CONFIG_PTHREAD_TASK_STACK_SIZE_DEFAULT=4096
CONFIG_ESP_SYSTEM_PANIC_PRINT_REBOOT=y

CONFIG_PARTITION_TABLE_SINGLE_APP_LARGE=y
# optional but explicit:
# CONFIG_PARTITION_TABLE_CUSTOM is not set
```
